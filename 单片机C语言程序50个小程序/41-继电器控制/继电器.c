/*-----------------------------------------------
  名称：继电器控制
  公司：上海浩豚电子科技有限公司
  网站：www.doflye.cn
  编写：师访
  日期：2009.5
  修改：无
  内容：用杜邦线把继电器输入端口和P1.1连接起来 按键s1吸合 s2释放继电器
------------------------------------------------*/

#include<reg52.h>     //包含头文件，一般情况不需要改动，头文件包含特殊功能寄存器的定义

sbit key1=P3^0;//定义按键位置
sbit key2=P3^1;//定义按键位置
sbit RELAY = P1^1; //定义继电器位置
/******************************************************************/
/*                    延时函数                                    */
/******************************************************************/
void delay(unsigned int cnt)
{
 while(--cnt);
}
/******************************************************************/
/*                    主函数                                      */
/******************************************************************/
main()
{
 while(1)
      { 
      if(!key1)       //按下相应的按键
        {
		delay(5000);
        if(!key1)     //去抖后是否按下相应的按键
		  {
		   RELAY=1;   //继电器吸合
		  }
		}

	  if(!key2)       //按下相应的按键
        {
		delay(5000);
        if(!key2)     //去抖后是否按下相应的按键
		  {
		   RELAY=0;   //继电器释放
		  }
		}

      }
}
