
/*-----------------------------------------------
  名称：直流电机调速
  公司：上海浩豚电子科技有限公司
  网站：www.doflye.cn
  编写：师访
  日期：2009.5
  修改：无
  内容：1、学习目的：利用定时器产生PWM，了解原理和使用方法
        2、硬件要求：直流电机 定时器
        3、试验现象：按键调速，PWM部分显示速度档位，电机根据档位调节速度 这个需要把电机驱动输入端和PWM端连接起来
------------------------------------------------*/
#include<reg52.h>     //包含头文件，一般情况不需要改动，头文件包含特殊功能寄存器的定义

sbit KEY1 = P3^1;     //定义调速按键
sbit PWM = P1^5;      //定义调速端口
unsigned char CYCLE;  //定义周期 该数字X基准定时时间 如果是10 则周期是10 x 0.1ms
unsigned char PWM_ON ;//定义高电平时间
/******************************************************************/
/*                    延时函数                                    */
/******************************************************************/
void delay(unsigned int cnt)
{
 while(--cnt);
}
/******************************************************************/
/*                    主函数                                      */
/******************************************************************/
main()
{
unsigned char PWM_Num;//定义档位
TMOD |=0x01;//定时器设置 1ms in 12M crystal
TH0=(65536-1000)/256; 
TL0=(65536-1000)%256;//定时1mS 
IE= 0x82;  //打开中断
TR0=1;

CYCLE = 10;// 时间可以调整 这个是10步调整 周期10ms 8位PWM就是256步
while(1)
  {
if(!KEY1)
  {
   delay(10000);
   if(!KEY1)
     {
      PWM_Num++;
	  if(PWM_Num==4)PWM_Num=0;
       switch(PWM_Num){
       case 0:P0=0x06;PWM_ON=0;break;//高电平时长 
       case 1:P0=0x5B;PWM_ON=4;break;
       case 2:P0=0x4F;PWM_ON=6;break;
       case 3:P0=0x66;PWM_ON=8;break;
       default:break;
     }
   }
  }
 }

}
/******************************************************************/
/*                    定时器中断函数                              */
/******************************************************************/
void tim(void) interrupt 1 using 1
{
static unsigned char count; //
TH0=(65536-1000)/256; 
TL0=(65536-1000)%256;//定时1mS 

if (count==PWM_ON)
    {
     PWM = 1;        //灯灭 
    }
  count++;
if(count == CYCLE)
    {
    count=0;
	if(PWM_ON!=0)    //如果左右时间是0 保持原来状态
	   PWM = 0;      //灯亮

    }

}
