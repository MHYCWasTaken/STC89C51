/*******************************************************************************
*                 
*                 		       普中科技
--------------------------------------------------------------------------------
* 实 验 名		 : 流水灯实验
* 实验说明       : 延时实现LED流水灯效果P2口八个灯作跑马灯。采用了寄存器存中间数
* 连接方式       : 见接线图
* 注    意		 : 
*******************************************************************************/

//--包含你要使用的头文件
#include <reg52.h>	  //此文件中定义了51的一些特殊功能寄存器
#include <intrins.h>

//--声明全局函数--//
void Delay10ms(unsigned int c);   //延时10ms	    

/*******************************************************************************
* 函 数 名         : main
* 函数功能		   : 主函数
* 输    入         : 无
* 输    出         : 无
*******************************************************************************/

main()
{
	unsigned char LED;

	LED = 0xfe;	  //0xfe = 1111 1110

 	while (1)
	{
    	 P0 = LED;
		 Delay10ms(50);
		 LED = LED << 1;    //循环右移1位，点亮下一个LED "<<"为左移位
	 	 if (P0 == 0x00)	//当它全灭的时候，重新赋值
		 {
		 	LED = 0xfe;  	// 0xfe = 1111 1110
		 } 
   		 		 
	}
}

/*******************************************************************************
* 函 数 名         : Delay10ms
* 函数功能		   : 延时函数，延时10ms
* 输    入         : 无
* 输    出         : 无
*******************************************************************************/

void Delay10ms(unsigned int c)   //误差 0us
{
    unsigned char a, b;

	//--c已经在传递过来的时候已经赋值了，所以在for语句第一句就不用赋值了--//
    for (;c>0;c--)
	{
		for (b=38;b>0;b--)
		{
			for (a=130;a>0;a--);
		}
           
	}       
}




