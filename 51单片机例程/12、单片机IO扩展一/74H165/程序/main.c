/*******************************************************************************
*                 
*                 		       普中科技
--------------------------------------------------------------------------------
* 实 验 名		 : 74H165显示试验
* 实验说明       : 使用LED显示74H165的读取值
* 连接方式       : 见连接图
* 注    意		 : 
*******************************************************************************/

#include<reg51.h>
#include<intrins.h>

//--定义使用的IO口--//
#define GPIO_LED P0
sbit    IN_PL   = P1^6;    //主P1.6 接 CPU P1.4。
sbit    IN_Data = P1^7;    //数据通过P1.7脚移进单片机内处理
sbit    SCK    = P3^6;

//--声明全局函数--//
unsigned char Read74H165(void);

/*******************************************************************************
* 函 数 名         : main
* 函数功能		   : 主函数
* 输    入         : 无
* 输    出         : 无
*******************************************************************************/

void main()
{
	unsigned char h165Value;

	GPIO_LED = 0;
	while(1)
	{
		h165Value = Read74H165();
		if(h165Value != 0xFF)
		{
			GPIO_LED = ~h165Value;
		}	
	}	
}

/*******************************************************************************
* 函 数 名         : Read74H165
* 函数功能		   : 使用165读取一个字节数据
* 输    入         : 无
* 输    出         : 无
*******************************************************************************/

unsigned char Read74H165(void)
{  
  unsigned char i;
  unsigned char indata;
		
   IN_PL = 0;
   _nop_();        //短暂延时 产生一定宽度的脉冲
   IN_PL = 1;	   //将外部信号全部读入锁存器中
   _nop_(); 
              
   indata=0;   //保存数据的变量清0  
   for(i=0; i<8; i++)
    { 
	  indata = indata<<1;	   //左移一位
	  SCK = 0;   //时钟置0	 
      _nop_();
	  indata |= IN_Data;
      SCK = 1;   //时钟置1	  
	} 
   
   return(indata);	 
}