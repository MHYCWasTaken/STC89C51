/********************************************************************
* 文件名  ： 动态显示.c
* 描述    :  
* 创建人  ： 东流，2009年8月30日
* 版本号  ： 1.0
***********************************************************************/
#include<reg52.h>
#define uchar unsigned char
#define uint  unsigned int

//uchar code table[8] = {0x00,0x00,0x00,0x00,0x73,0x77,0x6d,0x6d};	 //显示PASS编码
uchar code table[8] = {0x00,0x00,0x00,0x76,0x79,0x38,0x38,0x3f};	 //显示HELL0编码
uchar code LED_W[8] = {0,1,2,3,4,5,6,7};
/********************************************************************
* 名称 : Delay_1ms()
* 功能 : 延时子程序，延时时间为 1ms * x
* 输入 : x (延时一毫秒的个数)
* 输出 : 无
***********************************************************************/
void Delay(uint i)
{
	uchar x,j;
	for(j=0;j<i;j++)
	for(x=0;x<=148;x++);	
}

/********************************************************************
* 名称 : Main()
* 功能 : 数码管的显示
* 输入 : 无
* 输出 : 无
***********************************************************************/
void Main(void)
{
	uchar i = 0,j = 0;
	while(1)
	{
		P0 = table[i];	    				//数码管段值
		P2 = LED_W[j];		                //点亮某一位数码管
		Delay(2);
		j++;
		i++;
		if(j == 8)			                //每个数码管都点亮了一次。
		{
			j = 0;
			i = 0;
		}
	}
}