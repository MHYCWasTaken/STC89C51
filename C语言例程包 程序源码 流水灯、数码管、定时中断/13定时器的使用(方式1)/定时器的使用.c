/********************************************************************
* 文件名  ： 定时器的使用.c
* 描述    :  用定时器的方式1来实现定时。
			 相对前面的软件延时，定时器的延时更为精确。
			 定时时间可用光盘中的“51定时器计算.exe”计算。该软件
			 位于单片机开发辅助工具文件夹中。
* 创建人  ： 东流，2009年4月8日
* 版本号  ： 2.0
***********************************************************************/
#include<reg52.h>
#define uchar unsigned char
#define uint  unsigned int 

uchar Count = 0;
uchar code table[10] = {0x3f,0x06,0x5b,0x4f,0x66,0x6d,0x7d,0x07,0x7f,0x6f};
/********************************************************************
* 名称 : Time0_Init()
* 功能 : 定时器的初始化，11.0592MZ晶振，50ms
* 输入 : 无
* 输出 : 无
***********************************************************************/
void Time0_Init()
{
	TMOD = 0x01;	
	TH0  = 0x4c;
	TL0  = 0x00;
	IE 	 = 0x82;	
	TR0 = 1;		
}
										 
/********************************************************************
* 名称 : Time0_Int()
* 功能 : 定时器中断，中断中实现 Count 加一
* 输入 : 无
* 输出 : 无
***********************************************************************/
void Time0_Int() interrupt 1
{
	TH0 = 0x4c;
	TL0 = 0x00;
	Count++;			//长度加1
}

/********************************************************************
* 名称 : Main()
* 功能 : 主函数
* 输入 : 无
* 输出 : 无
***********************************************************************/
void main()
{
	uchar i = 0;
	Time0_Init();
	while(1)
	{
		P0 = table[i % 10];	  //取 i 的个位
		while(1)
		{
			if(Count == 20)	  //当Count为 20 时，i 自加一次，20 * 50MS = 1S
			{
				Count = 0;
				i++;
				break;
			}
		}
	}
}