/********************************************************************
* 文件名  ： 定时器和外部中断.c
* 描述    :  外部中断和定时器一样，是单片机最基本也是最重要的两个功能.
* 创建人  ： 东流，2009年4月9日
* 版本号  ： 2.0
***********************************************************************/
#include<reg52.h>
#define uchar unsigned char
#define uint  unsigned int

sbit KEY = P3^2;
uchar Count = 0;
uchar code table[10] = {0x3f,0x06,0x5b,0x4f,0x66,0x6d,0x7d,0x07,0x7f,0x6f};

/********************************************************************
* 名称 : Delay()
* 功能 : 延时,延时时间为 10ms * del
* 输入 : del
* 输出 : 无
***********************************************************************/
void Delay(uint del)
{
	uint i,j;
	for(i=0; i<del; i++)
	for(j=0; j<1827; j++)    
	;
}

/********************************************************************
* 名称 : Outside_Init()
* 功能 : 外部中断0 的初始化
* 输入 : 无
* 输出 : 无
***********************************************************************/
void Outside_Init(void)
{
	IT0 = 1;  //负边沿触发
	EX0 = 1;  //外部中断0允许
}

/********************************************************************
* 名称 : Outside_Int()
* 功能 : 外部中断0 的中断处理

* 输入 : 无
* 输出 : 无
***********************************************************************/
void Outside_Int(void) interrupt 0
{
	Delay(3);	   //延时30ms，去掉这行会出现按一下中断几次的情况
	if(KEY == 0)   //对按键进行抗干扰处理
	{
		P0 = 0xff;
	}
	Delay(100);	
}

/********************************************************************
* 名称 : Time0_Init()
* 功能 : 定时器的初始化，11.0592MZ晶振，50ms
* 输入 : 无
* 输出 : 无
***********************************************************************/
void Time0_Init()
{
	TMOD = 0x01;	  //定时器0选用方式1
	TH0  = 0x4c;	  //初值的计算
	TL0  = 0x00;	
	TR0 = 1;		  //启动定时器
	ET0 = 1;		  //打开定时器中断允许位
}
										 
/********************************************************************
* 名称 : Time0_Int()
* 功能 : 定时器中断，中断中实现 Count 加一
* 输入 : 无
* 输出 : 无
***********************************************************************/
void Time0_Int() interrupt 1
{
	TH0 = 0x4c;
	TL0 = 0x00;
	Count++;			//长度加1
}

/********************************************************************
* 名称 : Main()
* 功能 : 外部中断试验主程序
* 输入 : 无
* 输出 : 无
***********************************************************************/
void Main(void)
{
	uint i = 0;
	Time0_Init();
	Outside_Init();
	EA = 1;                //打开总中断
	while(1)
	{
		P0 = table[i % 10];	  //取 i 的个位
		if(Count == 20)	  	  //当Count为 20 时，i 自加一次，20 * 50MS = 1S
		{
			Count = 0;
			i++;		
		}		
	}
}