/********************************************************************
* 文件名  ： 流水灯.c
* 描述    :  该程序实现LED的流水灯显示。
			 该程序用于学习 LED流水灯 的控制方法。
			 本例中是调用的 intrins.h 中的函数实现的循环移位。		 
* 创建人  ： 东流，2009年8月27日
* 版本号  ： 1.0
***********************************************************************/
#include<reg52.h>
#include<intrins.h>
#define uchar unsigned char
#define uint  unsigned int

/********************************************************************
* 名称 : Delay()
* 功能 : 延时,延时时间为 10ms * del
* 输入 : del
* 输出 : 无
***********************************************************************/
void Delay(uint del)
{
	uint i,j;
	for(i=0; i<del; i++)
	for(j=0; j<1827; j++)   
	;
}

/********************************************************************
* 名称 : Main()
* 功能 : 实现灯的闪烁
* 输入 : 无
* 输出 : 无
***********************************************************************/
void Main(void)
{
	uchar i;
	while(1)
	{
		P0 = 0x7f;					//P0.7亮亮
		for(i=0; i<7; i++)			//移位7次
		{
			P0 = _cror_(P0, 1);		//_crol_()这个函数在intrins.h中定义了，用于循环右移
			Delay(15);
		}
		P0 = 0xfe;
		for(i=0; i<7; i++)
		{
			P0 = _crol_(P0, 1);	    //用于循环左移
			Delay(15);
		}

	}
}