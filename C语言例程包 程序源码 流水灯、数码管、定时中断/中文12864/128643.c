/******************************************************************************
Copyright 2007 
All rights reserved.

文件名 ： .c
模块名称：st7920 并行方式驱动12864液晶驱动
功能概要：st7920显示驱动
完成日期：2007.07.08
驱动芯片：st7920
******************************************************************************/
#include <reg52.h>

#define uint  unsigned int
#define uchar unsigned char
#define x1    0x80
#define x2    0x88
#define y     0x80
#define comm  0
#define dat   1

sbit RS = P3^0;   //H=data; L="command";
sbit RW = P3^1;   //H=read; L="write";
sbit  E = P3^2;   //input enable;
sbit PSB= P3^3;   //H=并口; L="串口";
sbit RST= P3^5;   //Reset Signal 低电平有效

sbit busy=P0^7;   //lcd busy bit

void wr_lcd (uchar dat_comm,uchar content);
void chk_busy (void);
void delay (uint us);

uchar code tab1[]={
"欢迎你使用锐志电"
"能实验板功能超强"
"子的RZ-51PRO多功"
"学习单片机的首选"
};

uchar code tab31[]={
"欢迎光临锐志电子"
"WWW.RICHMCU.COM"
};
uchar code tab32[]={
/*--  调入了一幅图像：F:\梁\画图\HOCO12832.bmp  --*/
/*--  宽度x高度=128x32  --*/
0x00,0x00,0x00,0x00,0x00,0x00,0x00,0x00,0x00,0x00,0x00,0x00,0x00,0x00,0x00,0x00,
0x00,0x1E,0x00,0x00,0x00,0x00,0x00,0x07,0xF0,0x00,0x00,0x00,0x00,0x00,0x00,0x00,
0x00,0x7F,0x80,0x00,0x00,0x00,0x00,0x18,0x0C,0x00,0x00,0x01,0x00,0x00,0x00,0x00,
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0x00,0x00,0x00,0x00,0x00,0x00,0x10,0x00,0x00,0x00,0x00,0x00,0x00,0x00,0x00,0x00
};

uchar code tab5[]={
/*--  调入了一幅图像：F:\梁\画图\COCK.bmp  --*/
/*--  宽度x高度=128x64  --*/
0x00,0x00,0x00,0x00,0x00,0x00,0x00,0x00,
      0x00,0x00,0x00,0x00,0x00,0x00,0x00,0x00,
      0x00,0x00,0x00,0x00,0x00,0x00,0x00,0x00,
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      0x00,0x00,0x00,0x00,0x00,0x00,0x00,0x00
};


/******************************************************************************************
* 函数名称    ：
* 功能描述    ： 
* 参数        ：  参数名称： 输入/输出？ 类型  描述
* 
* 返回值      ：
* 作者        ：
* 创建日期    ：2006-12-19
* 全局变量    ：
* 全局静态变量：
* 局部静态变量：
*----------------------------------------修改历史------------------------------------------
* 当前版本    ：     修改人：                  修改日期：
* 修改说明    ：
******************************************************************************************/
void init_lcd (void)
{
   RST = 1;
   PSB = 1;
   wr_lcd(comm,0x30);  /*30---基本指令动作*/   
   wr_lcd(comm,0x01);  /*清屏，地址指针指向00H*/
   wr_lcd(comm,0x06);  /*光标的移动方向*/
   wr_lcd(comm,0x0c);  /*开显示，关游标*/
}

/******************************************************************************************
* 函数名称    ：chn_disp
* 功能描述    ： 显示汉字或字符
* 参数        ：  参数名称： 输入/输出？ 类型  描述
* 
* 返回值      ：
* 作者        ：
* 创建日期    ：2006-12-19
* 全局变量    ：
* 全局静态变量：
* 局部静态变量：
*----------------------------------------修改历史------------------------------------------
* 当前版本    ：     修改人：                  修改日期：
* 修改说明    ：
******************************************************************************************/
void chn_disp(uchar code *chn)
{
   uchar i,j;
   wr_lcd(comm,0x30);
   wr_lcd(comm,0x80);
   for(j=0;j<4;j++)
   {
     for(i=0;i<16;i++)
     wr_lcd(dat,chn[j*16+i]);
   }
}

/******************************************************************************************
* 函数名称    ：chn_disp1
* 功能描述    ： 上半屏显示汉字或字符
* 参数        ：  参数名称： 输入/输出？ 类型  描述
* 
* 返回值      ：
* 作者        ：
* 创建日期    ：2006-12-19
* 全局变量    ：
* 全局静态变量：
* 局部静态变量：
*----------------------------------------修改历史------------------------------------------
* 当前版本    ：     修改人：                  修改日期：
* 修改说明    ：
******************************************************************************************/
void chn_disp1(uchar code *chn)
{
   uchar i,j;
   wr_lcd(comm,0x30);
   wr_lcd(comm,0x80);
   j=0;
   for(i=0;i<16;i++)
   wr_lcd(dat,chn[j*16+i]);
   wr_lcd(comm,0x90);
   j=1;
   for(i=0;i<16;i++)
   wr_lcd(dat,chn[j*16+i]);
}

/******************************************************************************************
* 函数名称    ：img_disp
* 功能描述    ： 显示图形
* 参数        ：  参数名称： 输入/输出？ 类型  描述
* 
* 返回值      ：
* 作者        ：
* 创建日期    ：2006-12-19
* 全局变量    ：
* 全局静态变量：
* 局部静态变量：
*----------------------------------------修改历史------------------------------------------
* 当前版本    ：     修改人：                  修改日期：
* 修改说明    ：
******************************************************************************************/
void img_disp(uchar code *img)
{
   uchar i,j;
   for(j=0;j<32;j++)
   {
     for(i=0;i<8;i++)
     {
       wr_lcd(comm,0x34);
       wr_lcd(comm,y+j);
       wr_lcd(comm,x1+i);
       wr_lcd(comm,0x30);
       wr_lcd(dat,img[j*16+i*2]);
       wr_lcd(dat,img[j*16+i*2+1]);
     }
   }
   for(j=32;j<64;j++)
   {
     for(i=0;i<8;i++)
     {
       wr_lcd(comm,0x34);
       wr_lcd(comm,y+j-32);
       wr_lcd(comm,x2+i);
       wr_lcd(comm,0x30);
       wr_lcd(dat,img[j*16+i*2]);
       wr_lcd(dat,img[j*16+i*2+1]);
     }
   }
   wr_lcd (comm,0x36);
}

/******************************************************************************************
* 函数名称    ：img_disp1
* 功能描述    ： 下半屏显示图形
* 参数        ：  参数名称： 输入/输出？ 类型  描述
* 
* 返回值      ：
* 作者        ：
* 创建日期    ：2006-12-19
* 全局变量    ：
* 全局静态变量：
* 局部静态变量：
*----------------------------------------修改历史------------------------------------------
* 当前版本    ：     修改人：                  修改日期：
* 修改说明    ：
******************************************************************************************/
void img_disp1(uchar code *img)
{
   uchar i,j;
   for(j=0;j<32;j++)
   {
     for(i=0;i<8;i++)
     {
       wr_lcd(comm,0x34);
       wr_lcd(comm,y+j);
       wr_lcd(comm,x2+i);
       wr_lcd(comm,0x30);
       wr_lcd(dat,img[j*16+i*2]);
       wr_lcd(dat,img[j*16+i*2+1]);
     }
   }
   wr_lcd(comm,0x36);
}

/******************************************************************************************
* 函数名称    ：lat_disp
* 功能描述    ： 显示点阵
* 参数        ：  参数名称： 输入/输出？ 类型  描述
* 
* 返回值      ：
* 作者        ：
* 创建日期    ：2006-12-19
* 全局变量    ：
* 全局静态变量：
* 局部静态变量：
*----------------------------------------修改历史------------------------------------------
* 当前版本    ：     修改人：                  修改日期：
* 修改说明    ：
******************************************************************************************/
void lat_disp(uchar data1,uchar data2)
{
   uchar i,j,k,x;
   x=x1;
   for(k=0;k<2;k++)
   {
     for(j=0;j<16;j++)
     {
       for(i=0;i<8;i++)
       {
         wr_lcd(comm,0x34);
          wr_lcd(comm,y+j*2);
         wr_lcd(comm,x+i);
         wr_lcd(comm,0x30);
         wr_lcd(dat,data1);
         wr_lcd(dat,data1);
       }
       for(i=0;i<8;i++)
       {
         wr_lcd(comm,0x34);
         wr_lcd(comm,y+j*2+1);
         wr_lcd(comm,x+i);
         wr_lcd(comm,0x30);
         wr_lcd(dat,data2);
         wr_lcd(dat,data2);
       }
     }
     x=x2;
   }
   wr_lcd(comm,0x36);
}

/******************************************************************************************
* 函数名称    ：con_disp
* 功能描述    ： 当data1=0xff,data2=0xff时,在x0,y0处反白显示16xl*yl
* 参数        ：  参数名称： 输入/输出？ 类型  描述
* 
* 返回值      ：
* 作者        ：
* 创建日期    ：2006-12-19
* 全局变量    ：
* 全局静态变量：
* 局部静态变量：
*----------------------------------------修改历史------------------------------------------
* 当前版本    ：     修改人：                  修改日期：
* 修改说明    ：
******************************************************************************************/
void con_disp(uchar data1,uchar data2,uchar x0,uchar y0,uchar xl,uchar yl)
{
   uchar i,j;
   for(j=0;j<yl;j++)
   {
     for(i=0;i<xl;i++)
     {
       wr_lcd(comm,0x34);
       wr_lcd(comm,y0+j);
       wr_lcd(comm,x0+i);
       wr_lcd(comm,0x30);
       wr_lcd(dat,data1);
       wr_lcd(dat,data2);
     }
   }
   wr_lcd(comm,0x36);
}

/******************************************************************************************
* 函数名称    ：clrram
* 功能描述    ： 清DDRAM
* 参数        ：  参数名称： 输入/输出？ 类型  描述
* 
* 返回值      ：
* 作者        ：
* 创建日期    ：2006-12-19
* 全局变量    ：
* 全局静态变量：
* 局部静态变量：
*----------------------------------------修改历史------------------------------------------
* 当前版本    ：     修改人：                  修改日期：
* 修改说明    ：
******************************************************************************************/
void clrram(void)
{
   wr_lcd(comm,0x30);
   wr_lcd(comm,0x01);
}

/******************************************************************************************
* 函数名称    ：wr_lcd
* 功能描述    ： 
* 参数        ：  参数名称： 输入/输出？ 类型  描述
* 
* 返回值      ：
* 作者        ：
* 创建日期    ：2006-12-19
* 全局变量    ：
* 全局静态变量：
* 局部静态变量：
*----------------------------------------修改历史------------------------------------------
* 当前版本    ：     修改人：                  修改日期：
* 修改说明    ：
******************************************************************************************/
void wr_lcd(uchar dat_comm,uchar content)
{
   chk_busy ();
   if(dat_comm)
    {
     RS = 1;   //data
     RW = 0;   //write
    }
   else 
    {
     RS = 0;   //command
     RW = 0;   //write
    }
   P0=content;   //output data or comm
   E = 1;
   ;
   E = 0;
}
/******************************************************************************************
* 函数名称    ：chk_busy
* 功能描述    ： 
* 参数        ：  参数名称： 输入/输出？ 类型  描述
* 
* 返回值      ：
* 作者        ：
* 创建日期    ：2006-12-19
* 全局变量    ：
* 全局静态变量：
* 局部静态变量：
*----------------------------------------修改历史------------------------------------------
* 当前版本    ：     修改人：                  修改日期：
* 修改说明    ：
******************************************************************************************/
void chk_busy(void)
{
   P0 = 0xff;
   RS = 0;
   RW = 1;
   E = 1;
   while(busy==1);
   E = 0;
}
/******************************************************************************************
* 函数名称    ：
* 功能描述    ： 
* 参数        ：  参数名称： 输入/输出？ 类型  描述
* 
* 返回值      ：
* 作者        ：
* 创建日期    ：2006-12-19
* 全局变量    ：
* 全局静态变量：
* 局部静态变量：
*----------------------------------------修改历史------------------------------------------
* 当前版本    ：     修改人：                  修改日期：
* 修改说明    ：
******************************************************************************************/
void delay(uint us)   //delay time
{
   while(us--);
}
/******************************************************************************************
* 函数名称    ：
* 功能描述    ： 
* 参数        ：  参数名称： 输入/输出？ 类型  描述
* 
* 返回值      ：
* 作者        ：
* 创建日期    ：2006-12-19
* 全局变量    ：
* 全局静态变量：
* 局部静态变量：
*----------------------------------------修改历史------------------------------------------
* 当前版本    ：     修改人：                  修改日期：
* 修改说明    ：
******************************************************************************************/
void delay1(uint ms)
{
   uint i,j;
   for(i=0;i<ms;i++)
   for(j=0;j<15;j++)
   delay(1);
}

/******************************************************************************************
* 函数名称    ：
* 功能描述    ： 
* 参数        ：  参数名称： 输入/输出？ 类型  描述
* 
* 返回值      ：
* 作者        ：
* 创建日期    ：2006-12-19
* 全局变量    ：
* 全局静态变量：
* 局部静态变量：
*----------------------------------------修改历史------------------------------------------
* 当前版本    ：     修改人：                  修改日期：
* 修改说明    ：
******************************************************************************************/
void main()
{
   SP=0x5f;
   init_lcd();
   while(1)
   {
     lat_disp(0x00,0x00);
     chn_disp(tab1);
     con_disp(0xff,0xff,0x8c,0x80,2,16);
     delay1(8000);
     clrram();
     //lat_disp(0xcc,0xcc);
     //delay1(8000);
     lat_disp(0x00,0x00);
     chn_disp1(tab31);
     img_disp1(tab32);
     delay1 (8000);
     clrram();
     //lat_disp (0xff,0x00);
    //delay1(8000);
     img_disp(tab5);
     delay1(8000);
   }
}


