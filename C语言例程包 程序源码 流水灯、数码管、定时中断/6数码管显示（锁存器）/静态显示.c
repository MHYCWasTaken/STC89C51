/********************************************************************
* 文件名  :  数码管显示.c
* 描述    :  该程序为数码管静态显示程序,并且通过实现锁存器的功能。
			 如果按了P3.2口，P3.7口由高电平变到低电平后，锁存器锁存功能使能。再按P3.4口，数码管的值就不会有所改变。
			 再按P3.2口，P3.7口电平由低变高，锁存功能失效。数码管的值又会改变。

* 创建人  ： 东流，2009年8月27日
* 版本号  ： 1.0
***********************************************************************/
#include<reg52.h>
#define uchar unsigned char
#define uint  unsigned int

sbit KEY = P3^4;	  //独立按键的T0
sbit KEY_Lock = P3^2; //这里，按了该按键后，实现解锁和开锁。
sbit LOCK = P3^7;     //锁存功能


/*下一行你可以试着把 code 去掉看看试验结果。 去掉后 table[] 会被存到 RAM 中，因为单片机的 RAM 比 ROM 小的多*/
/*所以，对于不会改变的值应该用 code 或者 #define 去定义，让这些固定值存到 ROM 中去*/
uchar code table[16] = {0x3f,0x06,0x5b,0x4f,0x66,0x6d,0x7d,0x07,0x7f,0x6f,0x77,0x7c,0x39,0x5e,0x79,0x71};
/*下一行的数组可以显示数值外，还可以显示数码管的点*/
uchar code table_d[16] = {0xbf,0x86,0xdb,0xcf,0xe6,0xed,0xfd,0x87,0xff,0xef,0xf7,0xfc,0xb9,0xde,0xf9,0xf1};

/********************************************************************
* 名称 : Delay()
* 功能 : 延时,延时时间为 10ms * del
* 输入 : del
* 输出 : 无
***********************************************************************/
void Delay(uint del)
{
	uint i,j;
	for(i=0; i<del; i++)
	for(j=0; j<1827; j++)    
	;
}

/********************************************************************
* 名称 : Main()
* 功能 : 主函数
* 输入 : 无
* 输出 : 无
***********************************************************************/
void main()
{
	uchar i = 0;
	LOCK = 1;
	//P2=0xff;
	while(1)
	{
		P0 = table[i % 16];	   //在这里取 i 的个位数，不带点显示
		//P0 = table_d[i % 16];      //带点显示
		if(KEY == 0)
		{
			Delay(1);              //软件消抖，试验为20ms
			if(KEY == 0)
			{
				i++;
			}
			Delay(50); 			   //延时0.5秒后进行下一次的按键检测
		}
		if(KEY_Lock == 0)
		{
			Delay(1);              //软件消抖，试验为20ms
			if(KEY_Lock == 0)
			{
				LOCK = !LOCK;	
			}
			Delay(50); 			   //延时0.5秒后进行下一次的按键检测	
		}		                
	}
}
