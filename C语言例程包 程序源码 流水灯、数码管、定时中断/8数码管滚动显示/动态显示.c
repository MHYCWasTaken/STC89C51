/********************************************************************
* 文件名  ： 动态显示.c
* 描述    :  
* 创建人  ： 东流，2009年8月30日
* 版本号  ： 1.0
***********************************************************************/
#include<reg52.h>
#define uchar unsigned char
#define uint  unsigned int

uchar code table[10] = {0x3f,0x06,0x5b,0x4f,0x66,0x6d,0x7d,0x07,0x7f,0x6f};
uchar code LED_W[8] = {0,1,2,3,4,5,6,7};
uint Time_temp = 0, LED_temp = 0;
/********************************************************************
* 名称 : Delay_1ms()
* 功能 : 延时子程序，延时时间为 1ms * x
* 输入 : x (延时一毫秒的个数)
* 输出 : 无
***********************************************************************/
void Delay(uint i)
{
	uchar x,j;
	for(j=0;j<i;j++)
	for(x=0;x<=148;x++);	
}

/********************************************************************
* 名称 : Time0_Init()
* 功能 : 定时器的初始化，11.0592MZ晶振，50ms
* 输入 : 无
* 输出 : 无
***********************************************************************/
void Time0_Init()
{
	TMOD = 0x01;
	IE 	 = 0x82;
	TH0  = 0x4c;
	TL0  = 0x00;	
	TR0 = 1;		
}

/********************************************************************
* 名称 : Time0_Int()
* 功能 : 定时器中断，中断中实现 Count 加一
* 输入 : 无
* 输出 : 无
***********************************************************************/
void Time0_Int() interrupt 1
{
	TH0 = 0x4c;
	TL0 = 0x00;
	Time_temp++;
	if(Time_temp == 4)		 //定时器溢出时间50毫秒，隔0.2秒，数码管的数据改变一次
	{
		LED_temp++;
		Time_temp = 0;
	} 			
}

/********************************************************************
* 名称 : Main()
* 功能 : 数码管的显示
* 输入 : 无
* 输出 : 无
***********************************************************************/
void Main(void)
{
	uchar i = 0,j = 0;
	Time0_Init();
	while(1)
	{
		P0 = table[(i + LED_temp) % 8];	    //数码管段值
		P2 = LED_W[j];		                //点亮某一位数码管
		Delay(2);
		j++;
		i++;
		if(j == 8)			                //每个数码管都点亮了一次。
		{
			j = 0;
			i = 0;
		}
	}
}