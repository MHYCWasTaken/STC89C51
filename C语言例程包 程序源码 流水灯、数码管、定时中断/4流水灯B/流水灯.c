/********************************************************************
* 文件名  ： 流水灯.c
* 描述    :  该程序实现LED的流水灯显示。
			 该程序用于学习 LED流水灯 的控制方法。	 
* 创建人  ： 东流，2009年8月27日
* 版本号  ： 1.0
***********************************************************************/
#include<reg52.h>
#define uchar unsigned char
#define uint  unsigned int

/********************************************************************
* 名称 : Delay()
* 功能 : 延时,延时时间为 10ms * del
* 输入 : del
* 输出 : 无
***********************************************************************/
void Delay(uint del)
{
	uint i,j;
	for(i=0; i<del; i++)
	for(j=0; j<1827; j++)   
	;
}

/********************************************************************
* 名称 : Main()
* 功能 : 实现灯的闪烁
* 输入 : 无
* 输出 : 无
* 说明 ：也可以使用例1的的方法来关闭数码管
***********************************************************************/
void Main(void)
{
	uchar i, temp;
	while(1)
	{
		temp = 0x7f;				
		for(i=0; i<7; i++)			
		{
			temp = temp >> 1;			//值右移一位
			temp = temp | 0x80;		
			P0 = temp;					//把值赋给P0口
			Delay(15);					//延时0.15秒
		}
		temp = 0xfe;
		for(i=0; i<7; i++)
		{
			temp = temp << 1;			//值左移一位
			temp = temp | 0x01;		
			P0 = temp;	    			//把值赋给P0口
			Delay(15);					//延时0.15秒
		}

	}
}