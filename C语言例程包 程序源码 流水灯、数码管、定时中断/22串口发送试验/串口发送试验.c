/********************************************************************
* 文件名  ： 串口发送试验.c
* 描述    :  该文件实现通过串口把数据从单片机发送到电脑，通过串口调试助手显示出来。
			 晶振需要用11.0592的。
* 创建人  ： 东流，2009年4月8日
* 版本号  ： 2.0
***********************************************************************/
#include<reg52.h>
#include<intrins.h>

#define uchar unsigned char
#define uint  unsigned int 

/********************************************************************
* 名称 : Com_Init()
* 功能 : 初始化串口程序，晶振11.0592, 波特率9600
* 输入 : 无
* 输出 : 无
***********************************************************************/
void Com_Init(void)
{
     TMOD = 0x20;
     PCON = 0x00;
     SCON = 0x50;			
     TH1 = 0xFd;
     TL1 = 0xFd;
     TR1 = 1;			
}

/********************************************************************
* 名称 : Main()
* 功能 : 主函数
* 输入 : 无
* 输出 : 无
***********************************************************************/
void Main()
{
	uchar i = 0;
	uchar code Buffer[] = "Welcome To The MCU World.           http://dlmcu.taobao.com               QQ:85536436            ";	 //所要发送的数据
	uchar *p;
	Com_Init();
	P2 = 0x00;
	p = Buffer;
	while(1)
	{
		
		SBUF = *p;
		while(!TI)                   //如果发送完毕，硬件会置位TI
		{
			_nop_();	
		}
		p++;
		if(*p == '\0') break;		//在每个字符串的最后，会有一个'\0'
		TI = 0;		                //TI清零
	}
	while(1);
}