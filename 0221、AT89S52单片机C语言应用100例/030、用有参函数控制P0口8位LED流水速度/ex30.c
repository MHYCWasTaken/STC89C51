//实例30：用有参函数控制P0口8位LED流水速度
#include<reg51.h>
/*************************************************
函数功能：延时一段时间
*************************************************/
void delay(unsigned char x)
{
  unsigned char m,n;
  for(m=0;m<x;m++)
    for(n=0;n<200;n++)
	        ;
}
/*************************************************
函数功能：主函数
*************************************************/
void main(void)
{  
  unsigned char i;     
  unsigned  char code Tab[ ]={0xFE,0xFD,0xFB,0xF7,0xEF,0xDF,0xBF,0x7F}; 
								//流水灯控制码  
  while(1)
    {
	   //快速流水点亮LED
	   for(i=0;i<8;i++) //共8个流水灯控制码
		 {
		   P0=Tab[i];
			delay(100);  //延时约60ms, (3*100*200=60 000μs）
		 }
	   //慢速流水点亮LED
	   for(i=0;i<8;i++) //共8个流水灯控制码
	    {
		   P0=Tab[i];
			delay(250);  //延时约150ms, (3*250*200=150 000μs）
	    }
	 }
}