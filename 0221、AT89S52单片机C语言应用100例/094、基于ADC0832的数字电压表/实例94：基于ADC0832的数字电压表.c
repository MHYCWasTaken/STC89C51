//实例94：基于ADC0832的数字电压表
#include<reg51.h>    //包含单片机寄存器的头文件
#include<intrins.h>  //包含_nop_()函数定义的头文件
sbit CS=P3^4;       //将CS位定义为P3.4引脚
sbit CLK=P1^0;      //将CLK位定义为P1.0引脚
sbit DIO=P1^1;       //将DIO位定义为P1.1引脚
//////////////////////////////////////////////////////////////////
unsigned char code digit[10]={"0123456789"};   //定义字符数组显示数字
unsigned char code Str[]={"Volt="};            //说明显示的是电压
/*******************************************************************************
以下是对液晶模块的操作程序
*******************************************************************************/
sbit RS=P2^0;           //寄存器选择位，将RS位定义为P2.0引脚
sbit RW=P2^1;           //读写选择位，将RW位定义为P2.1引脚
sbit E=P2^2;            //使能信号位，将E位定义为P2.2引脚
sbit BF=P0^7;           //忙碌标志位，，将BF位定义为P0.7引脚
/*****************************************************
函数功能：延时1ms
(3j+2)*i=(3×33+2)×10=1010(微秒)，可以认为是1毫秒
***************************************************/
void delay1ms()
{
   unsigned char i,j;	
	 for(i=0;i<10;i++)
	  for(j=0;j<33;j++)
	   ;		 
 }
/*****************************************************
函数功能：延时若干毫秒
入口参数：n
***************************************************/
 void delaynms(unsigned char n)
 {
   unsigned char i;
	for(i=0;i<n;i++)
	   delay1ms();
 }
/*****************************************************
函数功能：判断液晶模块的忙碌状态
返回值：result。result=1，忙碌;result=0，不忙
***************************************************/
bit BusyTest(void)
  {
    bit result;
	RS=0;       //根据规定，RS为低电平，RW为高电平时，可以读状态
    RW=1;
    E=1;        //E=1，才允许读写
    _nop_();   //空操作
    _nop_();
    _nop_(); 
    _nop_();   //空操作四个机器周期，给硬件反应时间	
    result=BF;  //将忙碌标志电平赋给result
   E=0;         //将E恢复低电平
   return result;
  }
/*****************************************************
函数功能：将模式设置指令或显示地址写入液晶模块
入口参数：dictate
***************************************************/
void WriteInstruction (unsigned char dictate)
{   
    while(BusyTest()==1);   //如果忙就等待
	 RS=0;                  //根据规定，RS和R/W同时为低电平时，可以写入指令
	 RW=0;   
	 E=0;                   //E置低电平(根据表8-6，写指令时，E为高脉冲，
                           // 就是让E从0到1发生正跳变，所以应先置"0"
	 _nop_();
	 _nop_();               //空操作两个机器周期，给硬件反应时间
	 P0=dictate;            //将数据送入P0口，即写入指令或地址
	 _nop_();
	 _nop_();
	 _nop_();
	 _nop_();               //空操作四个机器周期，给硬件反应时间
	 E=1;                   //E置高电平
	 _nop_();
	 _nop_();
	 _nop_();
	 _nop_();               //空操作四个机器周期，给硬件反应时间
	  E=0;                  //当E由高电平跳变成低电平时，液晶模块开始执行命令
 }
/*****************************************************
函数功能：指定字符显示的实际地址
入口参数：x
***************************************************/
 void WriteAddress(unsigned char x)
 {
     WriteInstruction(x|0x80); //显示位置的确定方法规定为"80H+地址码x"
 }
/*****************************************************
函数功能：将数据(字符的标准ASCII码)写入液晶模块
入口参数：y(为字符常量)
***************************************************/
 void WriteData(unsigned char y)
 {
    while(BusyTest()==1);  
	  RS=1;           //RS为高电平，RW为低电平时，可以写入数据
	  RW=0;
	  E=0;            //E置低电平(根据表8-6，写指令时，E为高脉冲，
                     // 就是让E从0到1发生正跳变，所以应先置"0"
	  P0=y;           //将数据送入P0口，即将数据写入液晶模块
	  _nop_();
	  _nop_();
 	  _nop_();
     _nop_();       //空操作四个机器周期，给硬件反应时间
	  E=1;           //E置高电平
	  _nop_();
	  _nop_();
	  _nop_();
	 _nop_();        //空操作四个机器周期，给硬件反应时间
	 E=0;            //当E由高电平跳变成低电平时，液晶模块开始执行命令
 }
/*****************************************************
函数功能：对LCD的显示模式进行初始化设置
***************************************************/
void LcdInitiate(void)
{
    delaynms(15);               //延时15ms，首次写指令时应给LCD一段较长的反应时间
    WriteInstruction(0x38);     //显示模式设置：16×2显示，5×7点阵，8位数据接口
	delaynms(5);                //延时5ms　，给硬件一点反应时间
    WriteInstruction(0x38);
	delaynms(5);               //延时5ms　，给硬件一点反应时间
	WriteInstruction(0x38);     //连续三次，确保初始化成功
	delaynms(5);               //延时5ms　，给硬件一点反应时间
	WriteInstruction(0x0c);     //显示模式设置：显示开，无光标，光标不闪烁
	delaynms(5);               //延时5ms　，给硬件一点反应时间
	WriteInstruction(0x06);     //显示模式设置：光标右移，字符不移
	delaynms(5);                //延时5ms　，给硬件一点反应时间
	WriteInstruction(0x01);     //清屏幕指令，将以前的显示内容清除
	delaynms(5);             //延时5ms　，给硬件一点反应时间

 }
/**************************************************************************
以下是电压显示的说明
**************************************************************************/
/*****************************************************
函数功能：显示电压符号
***************************************************/   
void display_volt(void)
 {
    unsigned char i;
	 WriteAddress(0x03);    //写显示地址，将在第2行第1列开始显示
	 i = 0;                //从第一个字符开始显示
	 while(Str[i] != '\0')  //只要没有写到结束标志，就继续写
	  {						
		 WriteData(Str[i]);   //将字符常量写入LCD
		 i++;                 //指向下一个字符				
		}	
}

/*****************************************************
函数功能：显示电压的小数点
***************************************************/   
void 	display_dot(void)
{         
	 WriteAddress(0x09);	  //写显示地址，将在第1行第10列开始显示		   
	 WriteData('.');       //将小数点的字符常量写入LCD		
}

/*****************************************************
函数功能：显示电压的单位(V)
***************************************************/   
void 	display_V(void)
{
    WriteAddress(0x0c); //写显示地址，将在第2行第13列开始显示	
	 WriteData('V');     //将字符常量写入LCD			
			
}
/*****************************************************
函数功能：显示电压的整数部分
入口参数：x
***************************************************/ 
void display1(unsigned char x)
{

	WriteAddress(0x08);    //写显示地址,将在第2行第7列开始显示
	WriteData(digit[x]);    //将百位数字的字符常量写入LCD
 }
/*****************************************************
函数功能：显示电压的小数数部分
入口参数：x
***************************************************/ 
 void display2(unsigned char x)
{
 	unsigned char i,j;
	i=x/10;            //取十位（小数点后第一位）
	j=x%10;            //取个位（小数点后第二位）
   WriteAddress(0x0a);      //写显示地址,将在第1行第11列开始显示
	WriteData(digit[i]);     //将小数部分的第一位数字字符常量写入LCD
	WriteData(digit[j]);     //将小数部分的第一位数字字符常量写入LCD
}
/*****************************************************
函数功能：将模拟信号转换成数字信号
***************************************************/ 
unsigned char  A_D()
{
  unsigned char i,dat;
   CS=1;   //一个转换周期开始
   CLK=0;  //为第一个脉冲作准备
   CS=0;  //CS置0，片选有效

   DIO=1;    //DIO置1，规定的起始信号  
   CLK=1;   //第一个脉冲
   CLK=0;   //第一个脉冲的下降沿，此前DIO必须是高电平
   DIO=1;   //DIO置1， 通道选择信号  
   CLK=1;   //第二个脉冲，第2、3个脉冲下沉之前，DI必须跟别输入两位数据用于选择通道，这里选通道CH0 
   CLK=0;   //第二个脉冲下降沿 
   DIO=0;   //DI置0，选择通道0
   CLK=1;    //第三个脉冲
   CLK=0;    //第三个脉冲下降沿 
   DIO=1;    //第三个脉冲下沉之后，输入端DIO失去作用，应置1
   CLK=1;    //第四个脉冲
   for(i=0;i<8;i++)  //高位在前
    {
      CLK=1;         //第四个脉冲
      CLK=0; 
      dat<<=1;       //将下面储存的低位数据向右移
		dat|=(unsigned char)DIO; 	 //将输出数据DIO通过或运算储存在dat最低位 
    }	  		        
    CS=1;          //片选无效 
	 return dat;	 //将读书的数据返回     
  }
/*****************************************************
函数功能：主函数
***************************************************/ 
main(void)
{
  unsigned int AD_val;    //储存A/D转换后的值
  unsigned char Int,Dec;   //分别储存转换后的整数部分与小数部分
   LcdInitiate();         //将液晶初始化
   delaynms(5);           //延时5ms给硬件一点反应时间	
	display_volt();        //显示温度说明
   display_dot();         //显示温度的小数点
   display_V();           //显示温度的单位
   while(1)
      {
		  AD_val= A_D();    //进行A/D转换
		  Int=(AD_val)/51;  //计算整数部分
		  Dec=(AD_val%51)*100/51;    //计算小数部分
        display1(Int);     //显示整数部分
		  display2(Dec);     //显示小数部分
		  delaynms(250);     //延时250ms
		}
		    
}