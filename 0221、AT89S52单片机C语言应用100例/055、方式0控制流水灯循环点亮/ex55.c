//实例55：方式0控制流水灯循环点亮
#include<reg51.h>   //包含51单片机寄存器定义的头文件
#include<intrins.h> //包含函数_nop_（）定义的头文件
unsigned char code Tab[]={0xFE,0xFD,0xFB,0xF7,0xEF,0xDF,0xBF,0x7F};//流水灯控制码，该数组被定义为全局变量
sbit P17=P1^7;
/**************************************************************
函数功能：延时约150ms
**************************************************************/
 void delay(void)   
{
   unsigned char m,n;
	 for(m=0;m<200;m++)
	  for(n=0;n<250;n++)	   
           ;
 }
/**************************************************************
函数功能：发送一个字节的数据
**************************************************************/
void Send(unsigned char dat)
{
  P17=0;     //P1.7引脚输出清0信号，对74LS164清0
  _nop_();   //延时一个机器周期
  _nop_();  //延时一个机器周期，保证清0完成
  P17=1;    //结束对74LS164的清0
  SBUF=dat;  //将数据写入发送缓冲器，启动发送
  while(TI==0)  //若没有发送完毕，等待
     ;
  TI=0;   //发送完毕，TI被置“1”，需将其清0
}
/*******************************************
函数功能：主函数
******************************************/	
void main(void)
  {
   unsigned char i;
   SCON=0x00;  //SCON=0000 0000B，使串行口工作于方式0   
	while(1)  
    {
	   for(i=0;i<8;i++)
	    {
	      Send(Tab[i]);  //发送数据
		   delay();       //延时
	     }
	  }
 }
		