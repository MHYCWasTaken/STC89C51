//实例8：用不同数据类型控制灯闪烁时间
#include<reg51.h>   //包含单片机寄存器的头文件
/******************************************************
函数功能：用整形数据延时一段时间
******************************************************/
void int_delay(void) //延时一段较长的时间
{
  unsigned int m;    //定义无符号整形变量，双字节数据，值域为0~65535
  for(m=0;m<36000;m++)
			 ;          //空操作      
}
/******************************************************
函数功能：用字符型数据延时一段时间
******************************************************/
void char_delay(void) //延时一段较短的时间
{
   unsigned char i,j;   //定义无符号字符型变量，单字节数据，值域0~255
	for(i=0;i<200;i++)
	  for(j=0;j<180;j++)
			   ;        //空操作
}
/******************************************************
函数功能：主函数
******************************************************/
void main(void)  
{
  unsigned char i;
  while(1)
	{
	  for(i=0;i<3;i++)
		 {
	     P1=0xfe;     //P1.0口的灯点亮
		  int_delay(); //延时一段较长的时间
		  P1=0xff;     //熄灭
		  int_delay(); //延时一段较长的时间
		 }
     for(i=0;i<3;i++)
		 {
	     P1=0xef;     //P1.4口的灯点亮
		  char_delay(); //延时一段较长的时间
		  P1=0xff;     //熄灭
		  char_delay(); //延时一段较长的时间
		 }	 
		
	  }

 }

	     




