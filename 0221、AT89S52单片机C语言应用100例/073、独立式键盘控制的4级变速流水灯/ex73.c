//实例73：独立式键盘控制的4级变速流水灯
#include<reg51.h>        //  包含51单片机寄存器定义的头文件
unsigned char speed;    //储存流水灯的流动速度
sbit S1=P1^4;          //位定义S1为P1.4
sbit S2=P1^5;          //位定义S2为P1.5
sbit S3=P1^6;          //位定义S3为P1.6
sbit S4=P1^7;          //位定义S4为P1.7
/**************************************************************
函数功能：延时20ms的子程序
**************************************************************/
void delay20ms(void)    //3*i*j+2*i=3*100*60+2*100=20000μs=20ms;
{
  unsigned char i,j;
  for(i=0;i<100;i++)
   for(j=0;j<60;j++)
	   ;
}
/**************************************************************
函数功能：延时可调子程序
入口参数：x
**************************************************************/
void delay(unsigned char x)
   {
	  unsigned char k;
	  for(k=0;k<x;k++)
	  	 delay20ms();
	}
/**************************************************************
函数功能：主函数
**************************************************************/
void main(void)
{
   TMOD=0x02;     //使用定时器T0的模式2
  	EA=1;          //开总中断
	ET0=1;         //定时器T0中断允许
	TR0=1;         //定时器T0开始运行
	TH0=256-200;   //定时器T0赋初值,每200微妙来1次中断请求
	TL0=256-200;
  speed=3;        //默认流水灯流水点亮延时20ms×3=60ms
   while(1)
	  {
		    P3=0xfe;         //第一个灯亮
		    delay(speed);    //调用延时可调子程序
		    P3=0xfd;         //第二个灯亮
		    delay(speed);
		    P3=0xfb;          //第三个灯亮
		   delay(speed);
		   P3=0xf7;          //第四个灯亮
		   delay(speed);
		  P3=0xef;          //第五个灯亮
	      delay(speed);
			P3=0xdf;          //第六个灯亮
	 	   delay(speed);
			P3=0xbf;          //第七个灯亮
	        delay(speed);
			P3=0x7f;          //第八个灯亮
	       delay(speed);    
 	        P3=0xff;
      }
   }
/**************************************************************
函数功能：定时器T0的中断服务子程序,进行键盘扫描
**************************************************************/
void intersev(void) interrupt 1 using 1
{
  TR0=0;            //关闭定时器T0/
  P1=0xff;           //将P1口的均置高电平"1"
  if((P1&0xf0)!=0xf0)    //如果有键按下
    {
	   delay20ms();       //延时20ms,软件消抖
	    if((P1&0xf0)!=0xf0)  //确实有键按下
		  {
		     if(S1==0)       //如果是按键S1按下
			      speed=5;   //流水灯流水点亮延时20ms×5=100ms
			  if(S2==0)      //如果是按键S2按下
			      speed=10;   //流水灯流水点亮延时20ms×10=200ms
			  if(S3==0)      //如果是按键S3按下
			      speed=25;  //流水灯流水点亮延时20ms×25=500ms
			  if(S4==0)      //如果是按键S4按下
			      speed=50;  //流水灯流水点亮延时20ms×50=1000ms
		   }	
	 }	
  	TR0=1;               //启动定时器T0
}
